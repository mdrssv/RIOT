## steval-mkboxpro/Kconfig
```kconfig
# Copyright (c) 2024 SSV Software Systems GmbH
#
# This file is subject to the terms and conditions of the GNU Lesser
# General Public License v2.1. See the file LICENSE in the top level
# directory for more details.

config BOARD
    default "steval-mkboxpro" if BOARD_STEVAL_MKBOXPRO

config BOARD_STEVAL_MKBOXPRO
    bool
    default y
    select CPU_MODEL_STM32U585AI

    # Put defined MCU peripherals here (in alphabetical order)
    select HAS_PERIPH_I2C
    select HAS_PERIPH_TIMER
    select HAS_PERIPH_UART
    select HAS_PERIPH_USBDEV
    select HAVE_SAUL_GPIO

    # Put other features for this board (in alphabetical order)
```
